/dts-v1/;
/plugin/;

/ {
    compatible = "brcm,bcm2835";

    fragment@0 {
        target = <&gpio>;
        __overlay__ {
            pps_gen_pins: pps_gen_pins {
                brcm,pins =     <18>;
                brcm,function = <1>;    // out
                brcm,pull =     <0>;    // off
            };
        };
    };

    fragment@1 {
        target-path = "/";
        __overlay__ {
            pps_gen: pps_gen {
                compatible      = "pps-gen-gpio";
                pinctrl-names   = "default";
                pinctrl-0       = <&pps_gen_pins>;
                pps-gen-gpios   = <&gpio 18 0>;
            };
        };
    };

    __overrides__ {
        gpiopin = <&pps_gen>,"pps-gen-gpios:4",
                  <&pps_gen_pins>,"brcm,pins:0";
    };
};
